## Documentation/devicetree/bindings/misc/xiaomi,pen-dock.yaml
```yaml
# SPDX-License-Identifier: (GPL-2.0-only OR BSD-2-Clause)
%YAML 1.2
---
$id: http://devicetree.org/schemas/misc/xiaomi,pen-dock.yaml#
$schema: http://devicetree.org/meta-schemas/core.yaml#

title: Xiaomi pen dock (magnetic stylus attachment) detection

maintainers:
  - TwinbornPlate75 <3342733415@qq.com>

description: |
  The stylus parks on the side of the tablet, held there by magnets. Hall
  sensors next to the park position pull their output low while the pen is
  attached. The state is exported by the pen dock driver so that the
  touchscreen can keep its pen sensing off while the pen is docked (a docked
  pen disturbs the digitizer) and the wireless pen charger can start charging.

properties:
  compatible:
    const: xiaomi,pen-dock

  pen-dock-gpios:
    description:
      Hall sensor outputs, asserted while the pen is attached. One entry per
      sensor; any asserted sensor means the pen is docked. The state is level
      held, so a pen that is already docked at probe time produces no edge
      interrupt.
    minItems: 1
    maxItems: 2

  wakeup-source: true

required:
  - compatible
  - pen-dock-gpios

additionalProperties: false

examples:
  - |
    pen-dock {
        compatible = "xiaomi,pen-dock";
        pen-dock-gpios = <&tlmm 101 GPIO_ACTIVE_LOW>,
                         <&tlmm 134 GPIO_ACTIVE_LOW>;
        pinctrl-names = "default";
        pinctrl-0 = <&hall_intr3_active &hall_intr4_active>;
        wakeup-source;
    };
```

## Documentation/devicetree/bindings/power/supply/qcom,pm8150b-bms.yaml
```yaml
# SPDX-License-Identifier: (GPL-2.0-only OR BSD-2-Clause)
%YAML 1.2
---
$id: http://devicetree.org/schemas/power/supply/qcom,pm8150b-bms.yaml#
$schema: http://devicetree.org/meta-schemas/core.yaml#

title: Qualcomm Unified Battery/Charger Manager

maintainers:
  - TwinbornPlate75 <3342733415@qq.com>

description: |
  The Qualcomm unified battery/charger manager is a virtual coordinator
  that aggregates the Qualcomm fuel gauge, PMIC charger, and optional
  direct chargers into user-facing qcom-battery and qcom-usb power
  supplies.  It does not own any hardware registers itself; the actual
  battery, charger and direct-charge devices are described by their own
  DT nodes and registered with the coordinator at runtime.

allOf:
  - $ref: power-supply.yaml#

properties:
  compatible:
    const: qcom,pm8150b-bms

  monitored-battery:
    description: Battery characteristics used for the default charge limits.

  qcom,tcpm-psy:
    $ref: /schemas/types.yaml#/definitions/phandle
    description: TCPM source power supply used to detect CC attach/detach.

  qcom,required-authenticators:
    $ref: /schemas/types.yaml#/definitions/uint32
    minimum: 0
    maximum: 3
    default: 0
    description: |
      Bit mask of battery authenticators which must pass before full-current
      charging is allowed. Bit 0 is primary and bit 1 is secondary.

  qcom,usb-icl-ua:
    $ref: /schemas/types.yaml#/definitions/uint32
    description: Maximum USB input current limit in microamperes.

  qcom,unverified-fcc-ua:
    $ref: /schemas/types.yaml#/definitions/uint32
    description: Fast-charge current limit while the battery is unauthenticated.

  qcom,unverified-fv-uv:
    $ref: /schemas/types.yaml#/definitions/uint32
    description: Float voltage limit while the battery is unauthenticated.

  qcom,dc-min-vbat-uv:
    $ref: /schemas/types.yaml#/definitions/uint32
    description: Minimum battery voltage before direct charging may start.

  qcom,dc-vbus-min-uv:
    $ref: /schemas/types.yaml#/definitions/uint32
    description: Minimum VBUS voltage for the 2:1 direct charger.

  qcom,dc-vbus-max-uv:
    $ref: /schemas/types.yaml#/definitions/uint32
    description: Maximum VBUS voltage for the 2:1 direct charger.

  qcom,dc-min-temp-decic:
    $ref: /schemas/types.yaml#/definitions/int32
    description: Minimum battery temperature for direct charging, in 0.1 C.

  qcom,dc-max-temp-decic:
    $ref: /schemas/types.yaml#/definitions/int32
    description: Maximum battery temperature for direct charging, in 0.1 C.

  qcom,jeita-hysteresis-decic:
    $ref: /schemas/types.yaml#/definitions/uint32
    description: JEITA table hysteresis in 0.1 C.

  qcom,jeita-too-cold:
    $ref: /schemas/types.yaml#/definitions/int32
    description: Temperature below which the battery is reported COLD.

  qcom,jeita-cool-th:
    $ref: /schemas/types.yaml#/definitions/int32
    description: Temperature below which the battery is reported COOL.

  qcom,jeita-warm-th:
    $ref: /schemas/types.yaml#/definitions/int32
    description: Temperature above which the battery is reported WARM.

  qcom,jeita-too-hot:
    $ref: /schemas/types.yaml#/definitions/int32
    description: Temperature above which the battery is reported HOT.

  qcom,jeita-fcc-ranges:
    $ref: /schemas/types.yaml#/definitions/int32-matrix
    description: |
      Temperature-based fast-charge current table.  Each entry is
      <low-decic high-decic current-ua>.

  qcom,jeita-fv-ranges:
    $ref: /schemas/types.yaml#/definitions/int32-matrix
    description: |
      Temperature-based float-voltage table.  Each entry is
      <low-decic high-decic voltage-uv>.

  qcom,thermal-mitigation-icl-ua:
    $ref: /schemas/types.yaml#/definitions/uint32-array
    description: Input current limit for each thermal mitigation level.

  qcom,thermal-mitigation-fcc-ua:
    $ref: /schemas/types.yaml#/definitions/uint32-array
    description: Fast-charge current limit for each thermal mitigation level.

  status:
    description: Standard device status property.

required:
  - compatible

additionalProperties: false

examples:
  - |
    battery-manager {
        compatible = "qcom,pm8150b-bms";
        monitored-battery = <&battery>;
        qcom,required-authenticators = <3>;
        qcom,usb-icl-ua = <3000000>;
        qcom,unverified-fcc-ua = <2000000>;
        qcom,unverified-fv-uv = <4450000>;
        qcom,dc-min-vbat-uv = <3500000>;
        qcom,dc-vbus-min-uv = <8500000>;
        qcom,dc-vbus-max-uv = <9600000>;
        qcom,dc-min-temp-decic = <0>;
        qcom,dc-max-temp-decic = <450>;
        qcom,jeita-fcc-ranges = <(-100) 0 820000>,
                                <151 480 5900000>,
                                <481 590 4260000>;
        qcom,jeita-fv-ranges = <(-100) 0 4450000>,
                               <151 480 4480000>,
                               <481 600 4100000>;
        status = "okay";
    };
```
